## config/boards/shields/tunne/Kconfig.defconfig
```kconfig
if SHIELD_TUNNE_LEFT

config ZMK_KEYBOARD_NAME
    default "tunne keyboard"

config ZMK_SPLIT_BLE_ROLE_CENTRAL
    default y

endif

if SHIELD_TUNNE_LEFT || SHIELD_TUNNE_RIGHT

config ZMK_SPLIT
    default y

endif
```

## config/boards/shields/tunne/Kconfig.shield
```kconfig
config SHIELD_TUNNE_LEFT
    def_bool $(shields_list_contains,tunne_left)
config SHIELD_TUNNE_RIGHT
    def_bool $(shields_list_contains,tunne_right)
```
